#include "GNSS.h"
#include <util/crc16.h>

unsigned char varicode[][3] = {
 /* Primary alphabet */
 { 1,15, 9}, { 1,15,10}, { 1,15,11}, { 1,15,12}, { 1,15,13}, { 1,15,14}, { 1,15,15}, { 2, 8, 8},
 { 2,12, 0}, { 2, 8, 9}, { 2, 8,10}, { 2, 8,11}, { 2, 8,12}, { 2,13, 0}, { 2, 8,13}, { 2, 8,14},
 { 2, 8,15}, { 2, 9, 8}, { 2, 9, 9}, { 2, 9,10}, { 2, 9,11}, { 2, 9,12}, { 2, 9,13}, { 2, 9,14},
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 { 1,14, 9}, { 1,14,10}, { 1,14,11}, { 1,14,12}, { 1,14,13}, { 1,14,14}, { 1,14,15}, { 1,15, 8},
 
/* Secondary alphabet */
 { 6,15, 9}, { 6,15,10}, { 6,15,11}, { 6,15,12}, { 6,15,13}, { 6,15,14}, { 6,15,15}, { 7, 8, 8},
 { 4,10,12}, { 7, 8, 9}, { 7, 8,10}, { 7, 8,11}, { 7, 8,12}, { 4,10,13}, { 7, 8,13}, { 7, 8,14},
 { 7, 8,15}, { 7, 9, 8}, { 7, 9, 9}, { 7, 9,10}, { 7, 9,11}, { 7, 9,12}, { 7, 9,13}, { 7, 9,14},
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 { 6,14, 9}, { 6,14,10}, { 6,14,11}, { 6,14,12}, { 6,14,13}, { 6,14,14}, { 6,14,15}, { 6,15, 8},
};
uint8_t _sym = 0;

#define ASCII 7          // ASCII 7 or 8
#define STOPBITS 2       // Either 1 or 2
#define TXDELAY 0        // Delay between sentence TX's
#define RTTY_BAUD 50    // Baud rate for use with RFM22B Max = 600
 
char datastring[80];
char txstring[80];
volatile int txstatus=1;
volatile int txstringlength=0;
volatile char txc;
volatile int txi;
volatile int txj;
unsigned int count=0;

uint8_t gps_hour = 0;
uint8_t gps_min = 0;
uint8_t gps_sec = 0;
double lat = 0;
double lng = 0;
unsigned int alt = 0;
uint16_t gps_sats = 0;
uint16_t gln_sats = 0;

uint8_t gpio_bit = 0;
uint8_t led = 13;

void setup() {
GnssConf.init();
// put your setup code here, to run once:
gnss_gpio_set_output(gpio_bit);
pinMode(led, OUTPUT);
Serial.config(STGNSS_UART_8BITS_WORD_LENGTH, STGNSS_UART_1STOP_BITS, STGNSS_UART_NOPARITY);
Serial.begin();

Serial.print("Timer Status:");
uint8_t tmr0 = Timer0.every(20, tmr_task); 
Serial.println(tmr0);

}

void loop()
{
// put your main code here, to run repeatedly:
//sprintf(datastring,"$$$$$M0UPU,%04u,RTTY TEST BEACON RTTY TEST BEACON",count); // Puts the text in the datastring
}

void task_called_after_GNSS_update(void)
{
  GnssInfo.update();
  gps_hour = GnssInfo.time.hour(); 
  gps_min = GnssInfo.time.minute();
  gps_sec = GnssInfo.time.second();
    
  lat = GnssInfo.location.latitude();
  lng = GnssInfo.location.longitude();
  
  alt = GnssInfo.altitude.meters();
  
  gps_sats = GnssInfo.satellites.numGPSInUse(NULL); 
  gln_sats = GnssInfo.satellites.numGLNInUse(NULL); 
    
}

void tmr_task(void)
{
  switch(txstatus) {
  case 0: // This is the optional delay between transmissions.
    txj++;
    if(txj>(TXDELAY*RTTY_BAUD)) {
      txj=0;
      txstatus=1;
    }
    break;
  case 1: // Initialise transmission, take a copy of the string so it doesn't change mid transmission.
    sprintf(datastring, "$$$$SPARK,%i,%02d%02d%02d,%.6f,%.6f,%i,%i,%i", count++, gps_hour, gps_min, gps_sec, lat, lng, alt, gps_sats, gln_sats);
    crccat(datastring + 4); //add checksum (lunars code)
    Serial.print(datastring);
    strcpy(txstring,datastring);
    txstringlength=strlen(txstring);
    txstatus=2;
    txj=0;
    break;
  case 2: // Grab a char and lets go transmit it.
    if ( txj < txstringlength)
    {
      txc = txstring[txj];
      txj++;
      txstatus=3;
      rtty_txbit (0); // Start Bit;
      txi=0;
    }
    else
    {
      txstatus=0; // Should be finished
      txj=0;
    }
    break;
  case 3:
    if(txi<ASCII)
    {
      txi++;
      if (txc & 1) rtty_txbit(1);
      else rtty_txbit(0);  
      txc = txc >> 1;
      break;
    }
    else
    {
      rtty_txbit (1); // Stop Bit
      txstatus=4;
      txi=0;
      break;
    }
  case 4:
    if(STOPBITS==2)
    {
      rtty_txbit (1); // Stop Bit
      txstatus=2;
      break;
    }
    else
    {
      txstatus=2;
      break;
    }
 
  }
}
  
  
  void rtty_txbit (int bit)
{
  if (bit)
  {
    digitalWrite(led, HIGH); // High
  }
  else
  {
    digitalWrite(led, LOW); // Low
  }
}

uint16_t crccat(char *msg)
{
  uint16_t x;
  for(x = 0xFFFF; *msg; msg++)
    x = crc_xmodem_update(x, *msg);
  snprintf(msg, 8, "*%04X\n", x);
  return(x);
}

uint16_t crc_xmodem_update (uint16_t crc, uint8_t data)
  {
      int i;
      crc = crc ^ ((uint16_t)data << 8);
      for (i=0; i<8; i++)
      {
          if (crc & 0x8000)
              crc = (crc << 1) ^ 0x1021;
          else
              crc <<= 1;
      }
      return crc;
  }
 
